/include/ "system-conf.dtsi"
/ {
    reserved-memory {
        #address-cells = <1>;
        #size-cells = <1>;
        ranges;
 
        reserved: buffer@0x20000000 {
            no-map;
            reg = <0x20000000 0x20000000>;
        };
    };
}; 
